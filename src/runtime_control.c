/* SPDX-License-Identifier: Apache-2.0 */

#include "runtime_control.h"

#include <csyn/csyn.h>

#include "Vehicles_Cubs2_OuterLoop.h"

#include <math.h>
#include <stddef.h>
#include <stdatomic.h>
#include <stdint.h>
#include <string.h>

#include <zephyr/kernel.h>
#include <zephyr/sys/util.h>

#include <flatcc/flatcc_builder.h>
#include <synapse/trajectory_reader.h>
#include <synapse/transfer_builder.h>
#include <synapse/transfer_reader.h>
#include <synapse/transfer_verifier.h>

#define CUBS2_MAX_SEGMENTS 6U
#define CUBS2_MAX_POINTS (CUBS2_MAX_SEGMENTS + 1U)
#define CUBS2_TRAJECTORY_ID 1U

struct runtime_value {
  const char *name;
  size_t live_offset;
  size_t mirror_offset;
  double min;
  double max;
};

/* Zenoh-pico invokes queryables from its native transport thread on
 * native_sim.  That thread is not owned by Zephyr's scheduler, so it must
 * never enter k_mutex (priority inheritance expects a Zephyr k_thread).
 * Represent cross-thread doubles as two atomic 32-bit words guarded by a
 * sequence counter.  Readers never block: a preempted writer is retried on a
 * later query/control cycle instead of deadlocking a single-core target. */
struct atomic_double {
  atomic_uint sequence;
  atomic_uint_least32_t low;
  atomic_uint_least32_t high;
};

struct runtime_control {
  Vehicles_Cubs2_OuterLoopState *model;
  atomic_uint plan_version;
  atomic_flag command_writer;
  atomic_bool pending_mission;
  atomic_uint mission_sequence;
  struct atomic_double pending_values[32];
  atomic_bool pending_value_set[32];
  struct atomic_double live_values[32];
  double applied_values[32];
  bool applied_value_set[32];
  struct atomic_double pending_waypoints[CUBS2_MAX_POINTS][3];
  atomic_uint pending_segments;
  double applied_waypoints[CUBS2_MAX_POINTS][3];
  uint32_t applied_segments;
  bool applied_mission;
};

static struct runtime_control g_runtime;

#define VALUE(field, mirror_field, lower, upper)                               \
  {                                                                            \
    #field, offsetof(Vehicles_Cubs2_OuterLoopState, field),                    \
        offsetof(Vehicles_Cubs2_OuterLoopState, mirror_field), lower, upper    \
  }

/* Keep hierarchical copies generated by Rumoca in sync.  These are the
 * actual leaves read by the corresponding controller blocks. */
static struct runtime_value values[] = {
    VALUE(route_cruiseSpeed, guidance_route_cruiseSpeed, 1.0, 12.0),
    VALUE(route_altitudeToFlightPathGain,
          guidance_route_altitudeToFlightPathGain, 0.0, 10.0),
    VALUE(route_altitudeLookaheadDistance,
          guidance_route_altitudeLookaheadDistance, 0.5, 50.0),
    VALUE(route_flightPathAngleLimit, guidance_route_flightPathAngleLimit, 0.02,
          0.7),
    VALUE(route_speedToAccelerationGain, guidance_route_speedToAccelerationGain,
          0.0, 10.0),
    VALUE(route_crossTrackSteeringDistance,
          guidance_route_crossTrackSteeringDistance, 0.25, 50.0),
    VALUE(route_waypointSwitchingDistance,
          guidance_route_waypointSwitchingDistance, 0.1, 50.0),
    VALUE(tecsParams_thrustKp, tecs_tecs_thrustKp, 0.0, 2.0),
    VALUE(tecsParams_thrustKi, tecs_tecs_thrustKi, 0.0, 2.0),
    VALUE(tecsParams_energyRateIntegralMax, tecs_tecs_energyRateIntegralMax,
          0.0, 100.0),
    VALUE(tecsParams_pitchKp, tecs_tecs_pitchKp, 0.0, 2.0),
    VALUE(tecsParams_pitchKi, tecs_tecs_pitchKi, 0.0, 2.0),
    VALUE(tecsParams_energyDistributionIntegralMax,
          tecs_tecs_energyDistributionIntegralMax, 0.0, 100.0),
    VALUE(tecsParams_pitchCommandLimit, tecs_tecs_pitchCommandLimit, 0.02, 0.7),
    VALUE(tecsParams_turnThrustGain, tecs_tecs_turnThrustGain, 0.0, 5.0),
    VALUE(tecsParams_turnPitchGain, tecs_tecs_turnPitchGain, -2.0, 2.0),
    VALUE(attitudeParams_rollLimit, attitude_params_rollLimit, 0.05, 1.2),
    VALUE(attitudeParams_rollRateLimit, attitude_params_rollRateLimit, 0.1,
          8.0),
    VALUE(attitudeParams_pitchCommandToElevatorGain,
          attitude_params_pitchCommandToElevatorGain, 0.0, 10.0),
    VALUE(attitudeParams_rollCommandToAileronGain,
          attitude_params_rollCommandToAileronGain, 0.0, 10.0),
    VALUE(attitude_headingPid_kp, attitude_headingController_params_kp, 0.0,
          10.0),
    VALUE(attitude_headingPid_ki, attitude_headingController_params_ki, 0.0,
          10.0),
    VALUE(attitude_headingPid_kd, attitude_headingController_params_kd, 0.0,
          10.0),
    VALUE(attitude_headingPid_integralMax,
          attitude_headingController_params_integralMax, 0.0, 10.0),
    VALUE(attitude_pitchPid_kp, attitude_pitchController_params_kp, 0.0, 10.0),
    VALUE(attitude_pitchPid_ki, attitude_pitchController_params_ki, 0.0, 10.0),
    VALUE(attitude_pitchPid_kd, attitude_pitchController_params_kd, 0.0, 10.0),
    VALUE(attitude_pitchPid_integralMax,
          attitude_pitchController_params_integralMax, 0.0, 10.0),
};

BUILD_ASSERT(ARRAY_SIZE(values) <= ARRAY_SIZE(g_runtime.pending_values));

static void atomic_double_init_value(struct atomic_double *slot,
                                     double value) {
  uint64_t bits;

  memcpy(&bits, &value, sizeof(bits));
  atomic_init(&slot->sequence, 0U);
  atomic_init(&slot->low, (uint32_t)bits);
  atomic_init(&slot->high, (uint32_t)(bits >> 32U));
}

static void atomic_double_store_value(struct atomic_double *slot,
                                      double value) {
  uint64_t bits;

  memcpy(&bits, &value, sizeof(bits));
  (void)atomic_fetch_add_explicit(&slot->sequence, 1U, memory_order_acq_rel);
  atomic_store_explicit(&slot->low, (uint32_t)bits, memory_order_relaxed);
  atomic_store_explicit(&slot->high, (uint32_t)(bits >> 32U),
                        memory_order_relaxed);
  (void)atomic_fetch_add_explicit(&slot->sequence, 1U, memory_order_release);
}

static bool atomic_double_try_load(const struct atomic_double *slot,
                                   double *value) {
  for (size_t attempt = 0U; attempt < 3U; attempt++) {
    uint32_t before =
        atomic_load_explicit(&slot->sequence, memory_order_acquire);
    uint32_t low;
    uint32_t high;
    uint32_t after;
    uint64_t bits;

    if ((before & 1U) != 0U) {
      continue;
    }
    low = atomic_load_explicit(&slot->low, memory_order_relaxed);
    high = atomic_load_explicit(&slot->high, memory_order_relaxed);
    after = atomic_load_explicit(&slot->sequence, memory_order_acquire);
    if (before != after || (after & 1U) != 0U) {
      continue;
    }
    bits = ((uint64_t)high << 32U) | low;
    memcpy(value, &bits, sizeof(*value));
    return true;
  }
  return false;
}

static void apply_value(Vehicles_Cubs2_OuterLoopState *model, size_t index,
                        double value) {
  *(double *)((uint8_t *)model + values[index].live_offset) = value;
  *(double *)((uint8_t *)model + values[index].mirror_offset) = value;
}

static void apply_route(Vehicles_Cubs2_OuterLoopState *model,
                        const double waypoints[CUBS2_MAX_POINTS][3],
                        uint32_t segments) {
  int32_t active_leg = CLAMP(model->currentWaypoint, 1, (int32_t)segments);

  model->route_nSegments = (int32_t)segments;
  model->guidance_route_nSegments = (int32_t)segments;
  for (size_t row = 0U; row < CUBS2_MAX_POINTS; row++) {
    size_t source_row = MIN(row, (size_t)segments);

    for (size_t column = 0U; column < 3U; column++) {
      model->route_waypoints[row][column] = waypoints[source_row][column];
      model->guidance_route_waypoints[row][column] =
          waypoints[source_row][column];
    }
  }

  /* Rumoca's route block reads previous_guidance_currentWaypoint at the next
   * step. Keep every public, nested, and previous-state copy on a valid leg
   * when a shorter route replaces the active mission. */
  model->currentWaypoint = active_leg;
  model->guidance_currentWaypoint = active_leg;
  model->guidance_activeWaypoint = active_leg;
  model->previous_guidance_currentWaypoint = active_leg;
  model->guidance_segmentEndIndex = active_leg + 1;
}

static const char *canonical_name(const char *name) {
  /* The public parameter names follow the Modelica names. */
  if (strcmp(name, "guidance.cruiseSpeed") == 0 ||
      strcmp(name, "velocity.setpoint") == 0) {
    return "route_cruiseSpeed";
  }
  static const struct {
    const char *public_name;
    const char *field;
  } aliases[] = {
      {"route.cruiseSpeed", "route_cruiseSpeed"},
      {"route.altitudeToFlightPathGain", "route_altitudeToFlightPathGain"},
      {"route.altitudeLookaheadDistance", "route_altitudeLookaheadDistance"},
      {"route.flightPathAngleLimit", "route_flightPathAngleLimit"},
      {"route.speedToAccelerationGain", "route_speedToAccelerationGain"},
      {"route.crossTrackSteeringDistance", "route_crossTrackSteeringDistance"},
      {"route.waypointSwitchingDistance", "route_waypointSwitchingDistance"},
      {"tecs.thrustKp", "tecsParams_thrustKp"},
      {"tecs.thrustKi", "tecsParams_thrustKi"},
      {"tecs.pitchKp", "tecsParams_pitchKp"},
      {"tecs.pitchKi", "tecsParams_pitchKi"},
      {"tecs.pitchCommandLimit", "tecsParams_pitchCommandLimit"},
      {"attitude.rollLimit", "attitudeParams_rollLimit"},
      {"attitude.rollRateLimit", "attitudeParams_rollRateLimit"},
      {"attitude.headingPid.kp", "attitude_headingPid_kp"},
      {"attitude.headingPid.ki", "attitude_headingPid_ki"},
      {"attitude.headingPid.kd", "attitude_headingPid_kd"},
      {"attitude.headingPid.integralMax", "attitude_headingPid_integralMax"},
      {"attitude.pitchPid.kp", "attitude_pitchPid_kp"},
      {"attitude.pitchPid.ki", "attitude_pitchPid_ki"},
      {"attitude.pitchPid.kd", "attitude_pitchPid_kd"},
      {"attitude.pitchPid.integralMax", "attitude_pitchPid_integralMax"},
  };
  for (size_t i = 0U; i < ARRAY_SIZE(aliases); i++) {
    if (strcmp(name, aliases[i].public_name) == 0) {
      return aliases[i].field;
    }
  }
  return name;
}

static int find_value(const char *name) {
  const char *canonical = canonical_name(name);

  for (size_t i = 0U; i < ARRAY_SIZE(values); i++) {
    if (strcmp(canonical, values[i].name) == 0) {
      return (int)i;
    }
  }
  return -1;
}

static bool finish_reply(flatcc_builder_t *builder, uint8_t *reply,
                         size_t capacity, size_t *reply_len) {
  size_t len;
  void *data = flatcc_builder_get_direct_buffer(builder, &len);

  if (data == NULL || len > capacity) {
    flatcc_builder_clear(builder);
    return false;
  }
  memcpy(reply, data, len);
  *reply_len = len;
  flatcc_builder_clear(builder);
  return true;
}

static bool build_param_set_reply(uint8_t *reply, size_t capacity,
                                  size_t *reply_len,
                                  synapse_types_CommandResultCode_enum_t result,
                                  const char *name, double value,
                                  int32_t detail) {
  flatcc_builder_t builder;

  if (flatcc_builder_init(&builder) != 0 ||
      synapse_cmd_ParamSetReply_start_as_root(&builder) != 0) {
    return false;
  }
  if (synapse_cmd_ParamSetReply_value_start(&builder) != 0 ||
      synapse_cmd_ParamValue_name_create_str(&builder,
                                             name == NULL ? "" : name) != 0 ||
      synapse_cmd_ParamValue_kind_add(&builder, synapse_cmd_ParamKind_Float) !=
          0 ||
      synapse_cmd_ParamValue_float_value_add(&builder, value) != 0 ||
      synapse_cmd_ParamSetReply_value_end(&builder) != 0 ||
      synapse_cmd_ParamSetReply_result_add(&builder, result) != 0 ||
      synapse_cmd_ParamSetReply_result_detail_add(&builder, detail) != 0 ||
      synapse_cmd_ParamSetReply_end_as_root(&builder) == 0) {
    flatcc_builder_clear(&builder);
    return false;
  }
  return finish_reply(&builder, reply, capacity, reply_len);
}

static bool build_param_get_reply(uint8_t *reply, size_t capacity,
                                  size_t *reply_len,
                                  synapse_types_CommandResultCode_enum_t result,
                                  const char *name, double value,
                                  int32_t detail) {
  flatcc_builder_t builder;

  if (flatcc_builder_init(&builder) != 0 ||
      synapse_cmd_ParamGetReply_start_as_root(&builder) != 0) {
    return false;
  }
  if (result == synapse_types_CommandResultCode_Accepted) {
    if (synapse_cmd_ParamGetReply_values_start(&builder) != 0 ||
        synapse_cmd_ParamGetReply_values_push_start(&builder) != 0 ||
        synapse_cmd_ParamValue_name_create_str(&builder, name) != 0 ||
        synapse_cmd_ParamValue_kind_add(&builder,
                                        synapse_cmd_ParamKind_Float) != 0 ||
        synapse_cmd_ParamValue_float_value_add(&builder, value) != 0 ||
        synapse_cmd_ParamGetReply_values_push_end(&builder) == NULL ||
        synapse_cmd_ParamGetReply_values_end(&builder) != 0) {
      flatcc_builder_clear(&builder);
      return false;
    }
  }
  if (synapse_cmd_ParamGetReply_result_add(&builder, result) != 0 ||
      synapse_cmd_ParamGetReply_total_add(
          &builder,
          result == synapse_types_CommandResultCode_Accepted ? 1U : 0U) != 0 ||
      synapse_cmd_ParamGetReply_result_detail_add(&builder, detail) != 0 ||
      synapse_cmd_ParamGetReply_end_as_root(&builder) == 0) {
    flatcc_builder_clear(&builder);
    return false;
  }
  return finish_reply(&builder, reply, capacity, reply_len);
}

static bool
build_trajectory_reply(uint8_t *reply, size_t capacity, size_t *reply_len,
                       synapse_types_CommandResultCode_enum_t result,
                       uint32_t plan_version, int32_t detail,
                       uint32_t failed_seq) {
  flatcc_builder_t builder;
  synapse_cmd_TrajectorySetReply_ref_t root;

  if (flatcc_builder_init(&builder) != 0 ||
      flatbuffers_buffer_start(
          &builder, synapse_cmd_TrajectorySetReply_file_identifier) != 0) {
    return false;
  }
  root = synapse_cmd_TrajectorySetReply_create(
      &builder, result, CUBS2_TRAJECTORY_ID, plan_version, detail, failed_seq,
      0U);
  if (root == 0 || flatbuffers_buffer_end(&builder, root) == 0) {
    flatcc_builder_clear(&builder);
    return false;
  }
  return finish_reply(&builder, reply, capacity, reply_len);
}

static uint32_t current_plan_version(void) {
  return atomic_load_explicit(&g_runtime.plan_version, memory_order_acquire);
}

static bool handle_param_set(const uint8_t *request, size_t request_len,
                             uint8_t *reply, size_t capacity,
                             size_t *reply_len) {
  synapse_cmd_ParamSetRequest_table_t root;
  synapse_cmd_ParamValue_table_t value;
  const char *name;
  double number;
  int index;

  if (request == NULL ||
      synapse_cmd_ParamSetRequest_verify_as_root(request, request_len) != 0) {
    return build_param_set_reply(reply, capacity, reply_len,
                                 synapse_types_CommandResultCode_Failed, "",
                                 0.0, -1);
  }
  root = synapse_cmd_ParamSetRequest_as_root(request);
  if (root == NULL ||
      (value = synapse_cmd_ParamSetRequest_value(root)) == NULL ||
      (name = synapse_cmd_ParamValue_name(value)) == NULL ||
      synapse_cmd_ParamValue_kind(value) != synapse_cmd_ParamKind_Float) {
    return build_param_set_reply(reply, capacity, reply_len,
                                 synapse_types_CommandResultCode_Failed, "",
                                 0.0, -1);
  }
  number = synapse_cmd_ParamValue_float_value(value);
  index = find_value(name);
  if (index < 0) {
    return build_param_set_reply(reply, capacity, reply_len,
                                 synapse_types_CommandResultCode_Unsupported,
                                 name, number, -2);
  }
  /* Numeric policy belongs to Electrode's checked LAN boundary.  This service
   * is available only on the localhost vehicle session, where the trusted
   * Ground Station must be able to tune beyond public-LAN limits.  Retain the
   * representation guard so NaN/Inf can never poison controller state. */
  if (!isfinite(number)) {
    return build_param_set_reply(reply, capacity, reply_len,
                                 synapse_types_CommandResultCode_Denied, name,
                                 number, -3);
  }

  if (atomic_flag_test_and_set_explicit(&g_runtime.command_writer,
                                        memory_order_acquire)) {
    return build_param_set_reply(
        reply, capacity, reply_len,
        synapse_types_CommandResultCode_TemporarilyRejected, name, number, -4);
  }
  atomic_double_store_value(&g_runtime.pending_values[index], number);
  atomic_store_explicit(&g_runtime.pending_value_set[index], true,
                        memory_order_release);
  atomic_flag_clear_explicit(&g_runtime.command_writer, memory_order_release);
  return build_param_set_reply(reply, capacity, reply_len,
                               synapse_types_CommandResultCode_Accepted, name,
                               number, 0);
}

static bool handle_param_get(const uint8_t *request, size_t request_len,
                             uint8_t *reply, size_t capacity,
                             size_t *reply_len) {
  synapse_cmd_ParamGetRequest_table_t root;
  const char *name;
  int index;
  double number;

  if (request == NULL ||
      synapse_cmd_ParamGetRequest_verify_as_root(request, request_len) != 0) {
    return build_param_get_reply(reply, capacity, reply_len,
                                 synapse_types_CommandResultCode_Failed, "",
                                 0.0, -1);
  }
  root = synapse_cmd_ParamGetRequest_as_root(request);
  if (root == NULL || (name = synapse_cmd_ParamGetRequest_name(root)) == NULL) {
    return build_param_get_reply(reply, capacity, reply_len,
                                 synapse_types_CommandResultCode_Failed, "",
                                 0.0, -1);
  }
  index = find_value(name);
  if (index < 0) {
    return build_param_get_reply(reply, capacity, reply_len,
                                 synapse_types_CommandResultCode_Unsupported,
                                 name, 0.0, -2);
  }
  if (!atomic_double_try_load(&g_runtime.live_values[index], &number)) {
    return build_param_get_reply(
        reply, capacity, reply_len,
        synapse_types_CommandResultCode_TemporarilyRejected, name, 0.0, -3);
  }
  return build_param_get_reply(reply, capacity, reply_len,
                               synapse_types_CommandResultCode_Accepted, name,
                               number, 0);
}

static bool handle_trajectory_set(const uint8_t *request, size_t request_len,
                                  uint8_t *reply, size_t capacity,
                                  size_t *reply_len) {
  synapse_cmd_TrajectorySetRequest_table_t root;
  synapse_topic_TrajectorySegmentData_vec_t segments;
  double waypoints[CUBS2_MAX_POINTS][3] = {0};
  uint32_t expected_version;
  uint32_t reply_version;
  size_t count;

  if (request == NULL || synapse_cmd_TrajectorySetRequest_verify_as_root(
                             request, request_len) != 0) {
    reply_version = current_plan_version();
    return build_trajectory_reply(reply, capacity, reply_len,
                                  synapse_types_CommandResultCode_Failed,
                                  reply_version, -1, 0U);
  }
  root = synapse_cmd_TrajectorySetRequest_as_root(request);
  if (root == NULL ||
      (segments = synapse_cmd_TrajectorySetRequest_segments(root)) == NULL) {
    reply_version = current_plan_version();
    return build_trajectory_reply(reply, capacity, reply_len,
                                  synapse_types_CommandResultCode_Failed,
                                  reply_version, -1, 0U);
  }
  count = synapse_topic_TrajectorySegmentData_vec_len(segments);
  if (count == 0U || count > CUBS2_MAX_SEGMENTS ||
      synapse_cmd_TrajectorySetRequest_total(root) != count) {
    reply_version = current_plan_version();
    return build_trajectory_reply(reply, capacity, reply_len,
                                  synapse_types_CommandResultCode_Denied,
                                  reply_version, -2, 0U);
  }

  for (size_t i = 0U; i < count; i++) {
    synapse_topic_TrajectorySegmentData_struct_t segment =
        synapse_topic_TrajectorySegmentData_vec_at(segments, i);
    const synapse_types_Vec3f_t *start =
        synapse_topic_TrajectorySegmentData_p0_enu_m(segment);
    const synapse_types_Vec3f_t *end =
        synapse_topic_TrajectorySegmentData_p1_enu_m(segment);

    if (synapse_topic_TrajectorySegmentData_segment_seq(segment) != i ||
        synapse_topic_TrajectorySegmentData_frame(segment) !=
            synapse_types_LocalFrame_LocalEnu ||
        !isfinite(start->x) || !isfinite(start->y) || !isfinite(start->z) ||
        !isfinite(end->x) || !isfinite(end->y) || !isfinite(end->z)) {
      reply_version = current_plan_version();
      return build_trajectory_reply(reply, capacity, reply_len,
                                    synapse_types_CommandResultCode_Denied,
                                    reply_version, -3, (uint32_t)i);
    }
    if (i == 0U) {
      waypoints[0][0] = start->x;
      waypoints[0][1] = start->y;
      waypoints[0][2] = start->z;
    }
    waypoints[i + 1U][0] = end->x;
    waypoints[i + 1U][1] = end->y;
    waypoints[i + 1U][2] = end->z;
  }

  expected_version = synapse_cmd_TrajectorySetRequest_expected_plan_version(root);
  if (atomic_flag_test_and_set_explicit(&g_runtime.command_writer,
                                        memory_order_acquire)) {
    return build_trajectory_reply(
        reply, capacity, reply_len,
        synapse_types_CommandResultCode_TemporarilyRejected,
        current_plan_version(), -5, 0U);
  }
  reply_version = current_plan_version();
  if (expected_version != 0U && expected_version != reply_version) {
    atomic_flag_clear_explicit(&g_runtime.command_writer, memory_order_release);
    return build_trajectory_reply(
        reply, capacity, reply_len,
        synapse_types_CommandResultCode_TemporarilyRejected, reply_version, -4,
        0U);
  }
  (void)atomic_fetch_add_explicit(&g_runtime.mission_sequence, 1U,
                                  memory_order_acq_rel);
  for (size_t row = 0U; row < CUBS2_MAX_POINTS; row++) {
    for (size_t column = 0U; column < 3U; column++) {
      atomic_double_store_value(&g_runtime.pending_waypoints[row][column],
                                waypoints[row][column]);
    }
  }
  atomic_store_explicit(&g_runtime.pending_segments, (uint32_t)count,
                        memory_order_relaxed);
  (void)atomic_fetch_add_explicit(&g_runtime.mission_sequence, 1U,
                                  memory_order_release);
  atomic_store_explicit(&g_runtime.pending_mission, true, memory_order_release);
  reply_version++;
  if (reply_version == 0U) {
    reply_version = 1U;
  }
  atomic_store_explicit(&g_runtime.plan_version, reply_version,
                        memory_order_release);
  atomic_flag_clear_explicit(&g_runtime.command_writer, memory_order_release);
  return build_trajectory_reply(reply, capacity, reply_len,
                                synapse_types_CommandResultCode_Accepted,
                                reply_version, 0, 0U);
}

static bool runtime_query(const uint8_t *request, size_t request_len,
                          uint8_t *reply, size_t capacity, size_t *reply_len,
                          void *user) {
  const char *service = user;

  if (strcmp(service, "param_set") == 0) {
    return handle_param_set(request, request_len, reply, capacity, reply_len);
  }
  if (strcmp(service, "param_get") == 0) {
    return handle_param_get(request, request_len, reply, capacity, reply_len);
  }
  if (strcmp(service, "trajectory_set") == 0) {
    return handle_trajectory_set(request, request_len, reply, capacity,
                                 reply_len);
  }
  return false;
}

bool cubs2_runtime_control_init(Vehicles_Cubs2_OuterLoopState *model) {
  if (model == NULL) {
    return false;
  }
  memset(&g_runtime, 0, sizeof(g_runtime));
  g_runtime.model = model;
  atomic_init(&g_runtime.plan_version, 1U);
  atomic_flag_clear(&g_runtime.command_writer);
  atomic_init(&g_runtime.pending_mission, false);
  atomic_init(&g_runtime.mission_sequence, 0U);
  atomic_init(&g_runtime.pending_segments, 0U);
  for (size_t i = 0U; i < ARRAY_SIZE(g_runtime.pending_values); i++) {
    double value = 0.0;

    if (i < ARRAY_SIZE(values)) {
      value = *(double *)((uint8_t *)model + values[i].live_offset);
    }
    atomic_double_init_value(&g_runtime.pending_values[i], value);
    atomic_double_init_value(&g_runtime.live_values[i], value);
    atomic_init(&g_runtime.pending_value_set[i], false);
  }
  for (size_t row = 0U; row < CUBS2_MAX_POINTS; row++) {
    for (size_t column = 0U; column < 3U; column++) {
      atomic_double_init_value(&g_runtime.pending_waypoints[row][column],
                               model->route_waypoints[row][column]);
    }
  }
  return csyn_zenoh_register_queryable("cmd/param_set", runtime_query,
                                       "param_set") &&
         csyn_zenoh_register_queryable("cmd/param_get", runtime_query,
                                       "param_get") &&
         csyn_zenoh_register_queryable("cmd/trajectory_set", runtime_query,
                                       "trajectory_set");
}

void cubs2_runtime_control_apply(Vehicles_Cubs2_OuterLoopState *model, bool armed) {
  /* Trusted runtime tuning and route replacement are deliberately available
   * in both manual and automatic flight.  Applying the complete transaction
   * at the cycle boundary below prevents partial controller updates; `armed`
   * is retained in the API so a future airframe policy can restrict updates. */
  ARG_UNUSED(armed);
  if (model == NULL) {
    return;
  }
  /* Apply the complete staged update at one controller-cycle boundary.  This
   * permits live in-flight tuning without allowing a model step to observe a
   * partially updated parameter set or route. */
  for (size_t i = 0U; i < ARRAY_SIZE(values); i++) {
    if (atomic_exchange_explicit(&g_runtime.pending_value_set[i], false,
                                 memory_order_acq_rel)) {
      double value;

      if (!atomic_double_try_load(&g_runtime.pending_values[i], &value)) {
        atomic_store_explicit(&g_runtime.pending_value_set[i], true,
                              memory_order_release);
        continue;
      }
      apply_value(model, i, value);
      atomic_double_store_value(&g_runtime.live_values[i], value);
      g_runtime.applied_values[i] = value;
      g_runtime.applied_value_set[i] = true;
    }
  }
  if (atomic_exchange_explicit(&g_runtime.pending_mission, false,
                               memory_order_acq_rel)) {
    double waypoints[CUBS2_MAX_POINTS][3];
    uint32_t before = atomic_load_explicit(&g_runtime.mission_sequence,
                                           memory_order_acquire);
    uint32_t segments;
    bool complete = (before & 1U) == 0U;

    for (size_t row = 0U; complete && row < CUBS2_MAX_POINTS; row++) {
      for (size_t column = 0U; column < 3U; column++) {
        complete = atomic_double_try_load(
            &g_runtime.pending_waypoints[row][column],
            &waypoints[row][column]);
        if (!complete) {
          break;
        }
      }
    }
    segments = atomic_load_explicit(&g_runtime.pending_segments,
                                    memory_order_relaxed);
    complete = complete &&
               before == atomic_load_explicit(&g_runtime.mission_sequence,
                                               memory_order_acquire);
    if (!complete) {
      atomic_store_explicit(&g_runtime.pending_mission, true,
                            memory_order_release);
      return;
    }
    apply_route(model, waypoints, segments);
    memcpy(g_runtime.applied_waypoints, waypoints, sizeof(waypoints));
    g_runtime.applied_segments = segments;
    g_runtime.applied_mission = true;
  }
}

void cubs2_runtime_control_restore(Vehicles_Cubs2_OuterLoopState *model) {
  if (model == NULL) {
    return;
  }

  for (size_t i = 0U; i < ARRAY_SIZE(values); i++) {
    if (g_runtime.applied_value_set[i]) {
      apply_value(model, i, g_runtime.applied_values[i]);
      atomic_double_store_value(&g_runtime.live_values[i],
                                g_runtime.applied_values[i]);
    }
  }
  if (g_runtime.applied_mission) {
    apply_route(model, g_runtime.applied_waypoints, g_runtime.applied_segments);
  }
}

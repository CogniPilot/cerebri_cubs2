## CMakeLists.txt
```
cmake_minimum_required(VERSION 3.20.0)

set(CUBS2_WORKSPACE_ROOT "" CACHE PATH "West workspace root containing Zephyr and module checkouts")
if(NOT CUBS2_WORKSPACE_ROOT AND DEFINED ENV{CUBS2_WORKSPACE_ROOT})
  set(CUBS2_WORKSPACE_ROOT "$ENV{CUBS2_WORKSPACE_ROOT}")
endif()

if(CUBS2_WORKSPACE_ROOT)
  get_filename_component(WORKSPACE_ROOT ${CUBS2_WORKSPACE_ROOT} ABSOLUTE)
else()
  get_filename_component(WORKSPACE_ROOT ${CMAKE_CURRENT_SOURCE_DIR} DIRECTORY)
endif()

function(cubs2_cache_path variable fallback description)
  if(DEFINED ENV{${variable}})
    set(default "$ENV{${variable}}")
  else()
    set(default "${fallback}")
  endif()
  set(${variable} "${default}" CACHE PATH "${description}")
endfunction()

cubs2_cache_path(CUBS2_CEREBRI_MODULES_ROOT
  "${WORKSPACE_ROOT}/modules/lib/cerebri_lockstep"
  "Cerebri Zephyr module source"
)
cubs2_cache_path(CUBS2_ZROS_ROOT
  "${WORKSPACE_ROOT}/modules/lib/zros"
  "ZROS Zephyr module source"
)
cubs2_cache_path(CUBS2_CSYN_ROOT
  "${WORKSPACE_ROOT}/modules/lib/csyn"
  "CSyn Zephyr module source"
)
cubs2_cache_path(CUBS2_MODELICA_MODELS_ROOT
  "${WORKSPACE_ROOT}/models/modelica_models"
  "Shared CogniPilot Modelica model library"
)

set(ZEPHYR_EXTRA_MODULES
  ${CUBS2_CEREBRI_MODULES_ROOT}
  ${CUBS2_ZROS_ROOT}
  ${CUBS2_CSYN_ROOT}
)

find_package(Zephyr REQUIRED HINTS $ENV{ZEPHYR_BASE})
project(cubs2 LANGUAGES C)

if(TARGET native_simulator AND CONFIG_CUBS2_SIM_TRANSPORT)
  target_sources(native_simulator INTERFACE subsys/lockstep/lockstep_host.c)
endif()

if(CONFIG_BOARD_MR_VMU_TROPIC_MIMXRT1064 AND CMAKE_C_COMPILER_ID STREQUAL "GNU"
   AND "${GNULD_VERSION_STRING}" VERSION_GREATER_EQUAL 2.39)
  # Zephyr's bare-metal GNU ld link uses -N, which creates a RWX load segment
  # in the ELF. This image is not a hosted executable, so silence ld.bfd's
  # generic RWX segment diagnostic for this firmware target. The flag itself
  # needs binutils >= 2.39 (SDK 0.17.3 ships 2.38, which errors on it).
  zephyr_link_libraries(${LINKERFLAGPREFIX},--no-warn-rwx-segments)
endif()

if(TARGET native_simulator AND CMAKE_C_COMPILER_ID STREQUAL "GNU" AND NOT CONFIG_64BIT)
  # Nix's multilib GCC wrapper searches both 32-bit and 64-bit library paths
  # while native_sim links with -m32. Tell ld.bfd not to warn when skipping the
  # incompatible 64-bit candidates it encounters before the matching libraries.
  target_link_options(native_simulator INTERFACE -Wl,--no-warn-search-mismatch)
endif()

find_package(Python3 REQUIRED COMPONENTS Interpreter)

set(CUBS2_RUMOCA_PYTHON "" CACHE FILEPATH
  "Python interpreter with the Rumoca binding used for Modelica code generation"
)

if(NOT CUBS2_RUMOCA_PYTHON
   AND DEFINED ENV{CUBS2_RUMOCA_PYTHON}
   AND NOT "$ENV{CUBS2_RUMOCA_PYTHON}" STREQUAL "")
  set(CUBS2_RUMOCA_PYTHON "$ENV{CUBS2_RUMOCA_PYTHON}" CACHE FILEPATH
    "Python interpreter with the Rumoca binding used for Modelica code generation"
    FORCE
  )
endif()

if(NOT CUBS2_RUMOCA_PYTHON)
  set(CUBS2_RUMOCA_PYTHON "${Python3_EXECUTABLE}" CACHE FILEPATH
    "Python interpreter with the Rumoca binding used for Modelica code generation"
    FORCE
  )
endif()

set(CUBS2_RUMOCA_GENERATED_DIR ${CMAKE_CURRENT_BINARY_DIR}/generated/rumoca)
set(CUBS2_EFMI_CONTROL_STAMPS)
set(CUBS2_EFMI_CONTROL_SOURCES)
set(CUBS2_EFMI_CONTROL_INCLUDE_DIRS)

file(GLOB_RECURSE CUBS2_MODELICA_SOURCES CONFIGURE_DEPENDS
  "${CUBS2_MODELICA_MODELS_ROOT}/*.mo"
)

function(cubs2_add_efmi_control_model model_file model_name generated_name)
  set(_model_file ${CUBS2_MODELICA_MODELS_ROOT}/${model_file})
  set(_efmu_dir ${CUBS2_RUMOCA_GENERATED_DIR}/${generated_name})
  set(_stamp ${CUBS2_RUMOCA_GENERATED_DIR}/${generated_name}.galec-production.stamp)
  set(_source ${_efmu_dir}/ProductionCode/${generated_name}.c)
  set(_header ${_efmu_dir}/ProductionCode/${generated_name}.h)

  add_custom_command(
    OUTPUT ${_stamp}
    BYPRODUCTS
      ${_efmu_dir}/AlgorithmCode/${model_name}.alg
      ${_efmu_dir}/AlgorithmCode/manifest.xml
      ${_source}
      ${_header}
      ${_efmu_dir}/ProductionCode/manifest.xml
      ${_efmu_dir}/__content.xml
    COMMAND ${CMAKE_COMMAND} -E rm -rf "${_efmu_dir}"
    COMMAND "${CUBS2_RUMOCA_PYTHON}"
            "-c"
            "from pathlib import Path; import sys; import rumoca as rum; model_file, model_name, target, output, source_root = sys.argv[1:6]; Path(output).mkdir(parents=True, exist_ok=True); generated = rum.Session(roots=[source_root]).codegen_file(model_file, model_name, target, output); [print(f'wrote {path}') for path in generated]"
            "${_model_file}"
            "${model_name}"
            "galec-production"
            "${_efmu_dir}"
            "${CUBS2_MODELICA_MODELS_ROOT}"
    COMMAND ${CMAKE_COMMAND} -E touch "${_stamp}"
    DEPENDS
      ${CUBS2_MODELICA_SOURCES}
    COMMENT "Generating ${model_name} eFMI Production Code with Rumoca Python binding"
    VERBATIM
  )

  list(APPEND CUBS2_EFMI_CONTROL_STAMPS ${_stamp})
  list(APPEND CUBS2_EFMI_CONTROL_SOURCES ${_source})
  list(APPEND CUBS2_EFMI_CONTROL_INCLUDE_DIRS ${_efmu_dir}/ProductionCode)
  set(CUBS2_EFMI_CONTROL_STAMPS ${CUBS2_EFMI_CONTROL_STAMPS} PARENT_SCOPE)
  set(CUBS2_EFMI_CONTROL_SOURCES ${CUBS2_EFMI_CONTROL_SOURCES} PARENT_SCOPE)
  set(CUBS2_EFMI_CONTROL_INCLUDE_DIRS ${CUBS2_EFMI_CONTROL_INCLUDE_DIRS} PARENT_SCOPE)
endfunction()

cubs2_add_efmi_control_model(
  Vehicles/Cubs2/OuterLoop.mo
  Vehicles.Cubs2.OuterLoop
  Vehicles_Cubs2_OuterLoop
)

add_custom_target(cubs2_efmi_control_codegen
  DEPENDS ${CUBS2_EFMI_CONTROL_STAMPS}
)

add_dependencies(app cubs2_efmi_control_codegen)

set_source_files_properties(${CUBS2_EFMI_CONTROL_SOURCES}
  PROPERTIES GENERATED TRUE
)

if(CMAKE_C_COMPILER_ID STREQUAL "GNU")
  set_source_files_properties(${CUBS2_EFMI_CONTROL_SOURCES}
    PROPERTIES COMPILE_OPTIONS -fno-var-tracking-assignments
  )
endif()

target_sources(app PRIVATE
  ${CUBS2_EFMI_CONTROL_SOURCES}
  ${synapse_fbs_c_SOURCE_DIR}/src/flatcc-runtime/builder.c
  ${synapse_fbs_c_SOURCE_DIR}/src/flatcc-runtime/emitter.c
  ${synapse_fbs_c_SOURCE_DIR}/src/flatcc-runtime/refmap.c
)

target_include_directories(app PRIVATE
  ${CUBS2_EFMI_CONTROL_INCLUDE_DIRS}
)

if(TARGET ..__modules__lib__zenoh-pico__zephyr)
  target_compile_options(..__modules__lib__zenoh-pico__zephyr PRIVATE
    -Wno-unused-function
    -Wno-unused-variable
  )
endif()

add_subdirectory(src)
add_subdirectory(subsys)
```

## Kconfig
```
source "Kconfig.zephyr"

menu "CUBS2"

config CUBS2_FASTDYN
	bool "Enable FastDyn hardware-target adapters"
	default n
	select CUBS2_SIM_TRANSPORT
	help
	  Retain the mr_vmu_tropic Cortex-M7 image, linker layout, Zephyr kernel,
	  Ethernet driver, and CUBS2 application while bypassing physical-only
	  board sequencing and analog clock setup during FastDyn/QEMU rehosting.

choice CUBS2_EXECUTION_MODE
	prompt "Controller execution mode"
	default CUBS2_LOCKSTEP if CUBS2_FASTDYN
	default CUBS2_REALTIME

config CUBS2_REALTIME
	bool "Realtime"
	help
	  Pace the controller on wall time. Deployed and native_sim builds consume
	  the direct Zenoh mocap pose stream. FastDyn consumes odometry through its
	  direct shared-memory simulation transport; its host bridge owns wall-time
	  pacing because Zephyr uptime is QEMU virtual time under FastDyn.

config CUBS2_LOCKSTEP
	bool "Deterministic lockstep"
	depends on BOARD_NATIVE_SIM || CUBS2_FASTDYN
	select CUBS2_SIM_TRANSPORT
	help
	  Advance the controller from simulator timestamps without wall-clock
	  pacing. Generated synapse_fbs payload structs use direct shared memory;
	  CSyn and ZROS may run concurrently as an independent side channel.

endchoice

config CUBS2_SIM_TRANSPORT
	bool
	select CEREBRI_LOCKSTEP
	help
	  Internal direct shared-memory transport used by native_sim lockstep and
	  both FastDyn execution modes.

config CUBS2_RUNTIME_CONTROL
	bool "Enable Zenoh runtime configuration services"
	depends on CSYN_ZENOH
	default y
	help
	  Register param_get, param_set, and trajectory_set queryable services.
	  Updates are staged by the Zenoh thread and applied at a controller-cycle
	  boundary. Network-free FastDyn builds leave this disabled automatically;
	  enabling the Zenoh side channel makes the services available again.

config CUBS2_MANUAL_OVERRIDE
	bool "Select manual or autonomous RC output from incoming RC switch"
	default y
	help
	  Mirror the CUBS2 fixed-wing bridge behavior: keep both the incoming
	  manual RC channels and the generated autonomous channels, then publish
	  manual channels when the mode switch is low and autonomous channels
	  when the mode switch is high. If manual channels or the switch do not
	  look like valid PWM values, the controller stays on autonomous output.

config CUBS2_AUTO_SWITCH_CHANNEL
	int "Incoming RC channel index used for manual/autonomous switch"
	depends on CUBS2_MANUAL_OVERRIDE
	default 4
	range 0 15
	help
	  Zero-based internal PWM channel index used as the source mode switch.
	  The manual-control bridge encodes flight mode on channel 4; channel 5
	  is reserved for the independent stabilization/active switch.

config CUBS2_AUTO_SWITCH_THRESHOLD_US
	int "Manual/autonomous switch PWM threshold"
	depends on CUBS2_MANUAL_OVERRIDE
	default 1500
	range 1000 2000
	help
	  Switch values above this threshold select autonomous output. Values at
	  or below this threshold select manual passthrough.

endmenu
```

## west.yml
```
# SPDX-License-Identifier: Apache-2.0

manifest:
  self:
    path: cerebri_cubs2
    west-commands: scripts/west-commands.yml

  remotes:
    - name: zephyrproject-rtos
      url-base: https://github.com/zephyrproject-rtos
    - name: cognipilot
      url-base: https://github.com/CogniPilot

  projects:
    - name: zephyr
      remote: cognipilot
      revision: c908d12ebc2baa679d0f5b8e31eeb459ea93caff # cerebri2 4/14/26
      path: zephyr
      west-commands: scripts/west-commands.yml
    - name: cmsis
      remote: zephyrproject-rtos
      revision: 512cc7e895e8491696b61f7ba8066b4a182569b8
      path: modules/hal/cmsis
    - name: cmsis_6
      remote: zephyrproject-rtos
      revision: 30a859f44ef8ab4dc8f84b03ed586fd16ccf9d74
      path: modules/hal/cmsis_6
    - name: hal_nxp
      remote: cognipilot
      revision: cf8f1631e862528ee044850bcc70273975b90771
      path: modules/hal/nxp
    - name: zros
      remote: cognipilot
      revision: 959bce412d6e12b3a49fb8b55c219affcf7f6d0e # cerebri2 4/14/26
      path: modules/lib/zros
    - name: csyn
      remote: cognipilot
      revision: a013673b3ae187b71d78809f5b501619517ed43a
      path: modules/lib/csyn
    - name: cerebri_modules
      remote: cognipilot
      revision: ef73a4f8adeb4385c34af4344c9af27e43e02033
      path: modules/lib/cerebri_lockstep
    - name: modelica_models
      remote: cognipilot
      revision: d319854bcbe5758f8beace3c99c6068796585d3f
      path: models/modelica_models
    - name: zenoh-pico
      url: https://github.com/cognipilot/zenoh-pico.git
      revision: cb9d8391c8e3c394fd288f2299c2b6758523b1c6 # cerebri2 4/27/26
      path: modules/lib/zenoh-pico
    - name: zephyr_boards
      remote: cognipilot
      revision: d006ec84e621ee33f43c233a96380c8c3f6470eb # cerebri2 4/14/26
      path: modules/lib/zephyr_boards
```

## prj.conf
```kconfig
CONFIG_MAIN_STACK_SIZE=6144
CONFIG_MAIN_THREAD_PRIORITY=2
CONFIG_SYSTEM_WORKQUEUE_STACK_SIZE=2048
CONFIG_THREAD_NAME=y
CONFIG_THREAD_MONITOR=y
CONFIG_THREAD_STACK_INFO=y
CONFIG_INIT_STACKS=y
CONFIG_THREAD_RUNTIME_STATS=y

CONFIG_FPU=y
CONFIG_POLL=y
CONFIG_HEAP_MEM_POOL_SIZE=32768
CONFIG_ZROS=y

CONFIG_LOG=y
CONFIG_LOG_MODE_IMMEDIATE=y
CONFIG_LOG_DEFAULT_LEVEL=2
CONFIG_LOG_CMDS=y
CONFIG_LOG_BACKEND_UART=n
CONFIG_LOG_PRINTK=n

CONFIG_CONSOLE=y
CONFIG_SERIAL=y
CONFIG_UART_ASYNC_API=y
CONFIG_UART_INTERRUPT_DRIVEN=y

CONFIG_SHELL=y
CONFIG_SHELL_BACKEND_SERIAL=y
CONFIG_SHELL_LOG_BACKEND=y
CONFIG_SHELL_PROMPT_UART="cubs2:~$ "
CONFIG_SHELL_STACK_SIZE=6144
CONFIG_DEVICE_SHELL=y
CONFIG_KERNEL_SHELL=y

CONFIG_CSYN=y
CONFIG_CSYN_SHELL=y

CONFIG_CUBS2_AUTO_SWITCH_CHANNEL=4
```

## boards/mr_vmu_tropic.conf
```kconfig
CONFIG_CODE_DATA_RELOCATION=y
CONFIG_POSIX_API=y
CONFIG_MAX_PTHREAD_MUTEX_COUNT=16
CONFIG_MAX_PTHREAD_COND_COUNT=8

CONFIG_MDIO=y
CONFIG_MDIO_SHELL=y
CONFIG_NETWORKING=y
CONFIG_NET_IPV4=y
CONFIG_NET_IPV6=n
CONFIG_NET_UDP=y
CONFIG_NET_CONFIG_SETTINGS=y
CONFIG_NET_CONFIG_NEED_IPV4=y
CONFIG_NET_CONFIG_INIT_TIMEOUT=0
CONFIG_NET_CONFIG_MY_IPV4_ADDR="192.0.2.1"
CONFIG_NET_CONFIG_MY_IPV4_NETMASK="255.255.255.0"
CONFIG_NET_CONFIG_PEER_IPV4_ADDR="192.0.2.2"
CONFIG_NET_SHELL=y
CONFIG_NET_STATISTICS=y
CONFIG_NET_STATISTICS_PER_INTERFACE=y
CONFIG_NET_STATISTICS_USER_API=y
CONFIG_NET_STATISTICS_IPV4=y
CONFIG_NET_STATISTICS_ICMP=y
CONFIG_NET_STATISTICS_UDP=y
CONFIG_NET_STATISTICS_ETHERNET=y

CONFIG_CSYN_ZENOH=y
CONFIG_CSYN_ZENOH_MODE="client"
CONFIG_CSYN_ZENOH_LOCATOR="udp/192.0.2.2:7447"
# Mocap arrives as RawPose on the app-declared qualisys/cub1/pose_raw topic.
```

## boards/mr_vmu_tropic_fastdyn_realtime.conf
```kconfig
# Rehost the realtime controller while retaining FastDyn's direct simulation
# transport. Run the FastDyn bridge with CUBS2_FASTDYN_SIM_SPEED=1 so its host
# clock paces incoming simulation timestamps in realtime.
CONFIG_CUBS2_REALTIME=y
```

## boards/native_sim.conf
```kconfig
CONFIG_NATIVE_SIM_SLOWDOWN_TO_REAL_TIME=y
CONFIG_REQUIRES_FULL_LIBC=y
CONFIG_ENTROPY_GENERATOR=y

CONFIG_CSYN_NATIVE_UDP=n
CONFIG_CSYN_ZENOH=y
CONFIG_CSYN_ZENOH_MODE="client"
CONFIG_CSYN_ZENOH_LOCATOR="udp/127.0.0.1:7447"
# Mocap arrives as RawPose on the app-declared qualisys/cub1/pose_raw topic.
```

## boards/native_sim_native_64.conf
```kconfig
CONFIG_NATIVE_SIM_SLOWDOWN_TO_REAL_TIME=y
CONFIG_REQUIRES_FULL_LIBC=y
CONFIG_ENTROPY_GENERATOR=y

CONFIG_CSYN_NATIVE_UDP=n
CONFIG_CSYN_ZENOH=y
CONFIG_CSYN_ZENOH_MODE="client"
CONFIG_CSYN_ZENOH_LOCATOR="udp/127.0.0.1:7447"
```

## boards/native_sim_sil.conf
```kconfig
# Lockstep SIL overlay: external odometry in (Zenoh bridge or shared-memory
# lockstep transport), no direct mocap subscription, no mission telemetry.
# Apply with: west build -b native_sim -- -DEXTRA_CONF_FILE=boards/native_sim_sil.conf
CONFIG_CUBS2_LOCKSTEP=y
CONFIG_CSYN_ZENOH_LOCATOR="udp/127.0.0.1:7448"
```

## boards/mr_vmu_tropic.overlay
```dts
/* SPDX-License-Identifier: Apache-2.0 */

/* CUBS2 uses the board Ethernet device and receives all flight inputs over Zenoh. */
```

## boards/native_sim.overlay
```dts
/* SPDX-License-Identifier: Apache-2.0 */

/* CUBS2 native_sim receives flight inputs through csyn/Zenoh, not fake devices. */
```

## boards/native_sim_native_64.overlay
```dts
/* SPDX-License-Identifier: Apache-2.0 */

/* CUBS2 native_sim/native/64 receives flight inputs through csyn/Zenoh. */
```

## src/main.c
```c
/*
 * SPDX-License-Identifier: Apache-2.0
 */

#include <csyn/csyn.h>
#include <csyn/csyn_codec.h>
#include <csyn/csyn_zros.h>

#include "FixedWingOuterLoop.h"
#include "lockstep.h"

#include <stdbool.h>
#include <stdint.h>

#include <zephyr/kernel.h>
#include <zephyr/logging/log.h>

#include <zros/zros_node.h>
#include <zros/zros_pub.h>
#include <zros/zros_sub.h>
#include <zros/zros_topic.h>

LOG_MODULE_REGISTER(cubs2, LOG_LEVEL_INF);

#define CUBS2_FIXED_WING_OUTER_LOOP_PERIOD_NS 20000000
#define CUBS2_CONTROL_PERIOD_US               (CUBS2_FIXED_WING_OUTER_LOOP_PERIOD_NS / 1000U)

/* The application owns its synapse_fbs 0.7 topic contract. CSyn resolves
 * these compact keys against the generated catalog and rejects mismatched
 * payload sizes during initialization. */
CSYN_TOPIC_DEFINE(manual, "manual", CSYN_DIR_RX, sizeof(synapse_topic_ManualControlData_t));
CSYN_TOPIC_DEFINE(odom, "odom", CSYN_DIR_RX, sizeof(synapse_topic_OdometryData_t));
CSYN_TOPIC_DEFINE(pwm, "pwm", CSYN_DIR_TX, sizeof(synapse_topic_PwmSignalOutputsData_t));
CSYN_TOPIC_DEFINE(health, "health", CSYN_DIR_TX, sizeof(synapse_topic_VehicleHealthData_t));
CSYN_TOPIC_DEFINE(att, "att", CSYN_DIR_TX, sizeof(synapse_topic_AttitudeEstimateData_t));
CSYN_TOPIC_DEFINE(att_sp, "att_sp", CSYN_DIR_TX, sizeof(synapse_topic_AttitudeCommandData_t));
CSYN_TOPIC_DEFINE(loop, "loop", CSYN_DIR_TX, sizeof(synapse_topic_ControlLoopMetricsData_t));
ZROS_TOPIC_DEFINE_SINGLE_PUBLISHER(manual_control, struct csyn_manual_control);
ZROS_TOPIC_DEFINE_SINGLE_PUBLISHER(odometry, synapse_topic_OdometryData_t);
ZROS_TOPIC_DEFINE_SINGLE_PUBLISHER(pwm_signal_outputs, synapse_topic_PwmSignalOutputsData_t);
ZROS_TOPIC_DEFINE_SINGLE_PUBLISHER(vehicle_health, synapse_topic_VehicleHealthData_t);
ZROS_TOPIC_DEFINE_SINGLE_PUBLISHER(attitude_estimate, synapse_topic_AttitudeEstimateData_t);
ZROS_TOPIC_DEFINE_SINGLE_PUBLISHER(attitude_command, synapse_topic_AttitudeCommandData_t);
ZROS_TOPIC_DEFINE_SINGLE_PUBLISHER(control_loop_metrics, synapse_topic_ControlLoopMetricsData_t);

struct control_context {
	synapse_topic_OdometryData_t odometry;
	struct csyn_manual_control manual;
	csyn_rc_channels16_t control_rc;
	synapse_topic_PwmSignalOutputsData_t pwm_outputs;
	synapse_topic_VehicleHealthData_t vehicle_health;
	synapse_topic_AttitudeEstimateData_t attitude_estimate;
	synapse_topic_AttitudeCommandData_t attitude_command;
	synapse_topic_ControlLoopMetricsData_t control_loop_metrics;
	uint32_t main_loop_us;
	uint64_t lockstep_time_us;
	uint64_t next_control_time_us;
	bool lockstep_time_valid;
	bool previous_auto_mode;
};

static FixedWingOuterLoopState g_model;
static struct control_context g_control_ctx;
static struct zros_node g_node;
static struct zros_pub g_pwm_outputs_pub;
static struct zros_pub g_vehicle_health_pub;
static struct zros_pub g_attitude_estimate_pub;
static struct zros_pub g_attitude_command_pub;
static struct zros_pub g_control_loop_metrics_pub;
static struct zros_sub g_odometry_sub;
static struct zros_sub g_manual_sub;

static bool read_odometry_if_updated(struct control_context *ctx)
{
	if (zros_sub_update(&g_odometry_sub) != 0) {
		return false;
	}

	ctx->lockstep_time_us = ctx->odometry.timestamp_us;
	ctx->lockstep_time_valid = true;
	return true;
}

static bool read_manual_if_updated(struct control_context *ctx)
{
	return zros_sub_update(&g_manual_sub) == 0;
}

static bool odometry_valid(const synapse_topic_OdometryData_t *odom)
{
	const uint32_t required = synapse_topic_OdometryFlags_PositionValid |
				  synapse_topic_OdometryFlags_AttitudeValid |
				  synapse_topic_OdometryFlags_LinearVelocityValid |
				  synapse_topic_OdometryFlags_AngularVelocityValid;
	const uint32_t reject = synapse_topic_OdometryFlags_OutlierRejected |
				synapse_topic_OdometryFlags_Lost;
	uint32_t flags = odom->flags;

	return (flags & required) == required && (flags & reject) == 0U &&
	       odom->status != synapse_topic_OdometryStatus_Lost &&
	       odom->status != synapse_topic_OdometryStatus_OutlierRejected;
}

static void fixed_wing_map_input(FixedWingOuterLoopState *model,
				 const synapse_topic_OdometryData_t *odom)
{
	float roll = 0.0f;
	float pitch = 0.0f;
	float yaw = 0.0f;

	/* FixedWingOuterLoop consumes Euler [roll, pitch, yaw] in radians. */
	csyn_euler_from_quatf(&odom->pose.attitude, &roll, &pitch, &yaw);

	model->position_m[0] = odom->pose.position_enu_m.x;
	model->position_m[1] = odom->pose.position_enu_m.y;
	model->position_m[2] = odom->pose.position_enu_m.z;
	model->euler_rad[0] = roll;
	model->euler_rad[1] = pitch;
	model->euler_rad[2] = yaw;
	model->velocity_m_s[0] = odom->twist.linear_velocity_enu_m_s.x;
	model->velocity_m_s[1] = odom->twist.linear_velocity_enu_m_s.y;
	model->velocity_m_s[2] = odom->twist.linear_velocity_enu_m_s.z;
	model->eulerRate_rad_s[0] = odom->twist.angular_velocity_flu_rad_s.roll;
	model->eulerRate_rad_s[1] = odom->twist.angular_velocity_flu_rad_s.pitch;
	model->eulerRate_rad_s[2] = odom->twist.angular_velocity_flu_rad_s.yaw;
}

static void fixed_wing_map_output(const FixedWingOuterLoopState *model, csyn_rc_channels16_t *rc)
{
	*rc = (csyn_rc_channels16_t){
		.ch0 = csyn_pwm_from_centered_axis(-(float)model->aileron),
		.ch1 = csyn_pwm_from_centered_axis(-(float)model->elevator),
		.ch2 = csyn_pwm_from_throttle_axis((float)model->throttle),
		.ch3 = csyn_pwm_from_centered_axis((float)model->rudder),
		.ch4 = (int32_t)csyn_clampf((float)model->stabilizer, 1000.0f, 2000.0f),
		.ch5 = (int32_t)model->currentWaypoint,
		.ch6 = (int32_t)(1000.0f * (float)model->desiredSpeed),
		.ch7 = (int32_t)(1000.0f * (float)model->rollCommand),
		.ch8 = (int32_t)(1000.0f * (float)model->courseError),
	};
}

static void idle_output(csyn_rc_channels16_t *rc)
{
	*rc = (csyn_rc_channels16_t){
		.ch0 = 1500,
		.ch1 = 1500,
		.ch2 = 1000,
		.ch3 = 1500,
		.ch4 = 1000,
	};
}

static bool manual_control_valid(const struct csyn_manual_control *manual, int32_t *switch_us)
{
	const int32_t *channels = csyn_rc_channels_data(&manual->rc);
	bool valid = manual->valid;

	*switch_us = channels[CONFIG_CUBS2_AUTO_SWITCH_CHANNEL];

	for (size_t i = 0U; i < 5U; i++) {
		valid = valid && (channels[i] >= 900) && (channels[i] <= 2100);
	}

	return valid && (*switch_us >= 900) && (*switch_us <= 2100);
}

static bool auto_mode_selected(const struct control_context *ctx)
{
#if defined(CONFIG_CUBS2_MANUAL_OVERRIDE)
	int32_t switch_us;

	return !manual_control_valid(&ctx->manual, &switch_us) ||
	       (switch_us > CONFIG_CUBS2_AUTO_SWITCH_THRESHOLD_US);
#else
	ARG_UNUSED(ctx);
	return true;
#endif
}

static int control_pubs_init(void)
{
	int rc;
	struct {
		struct zros_pub *pub;
		struct zros_topic *topic;
		void *msg;
	} pubs[] = {
		{&g_pwm_outputs_pub, &topic_pwm_signal_outputs, &g_control_ctx.pwm_outputs},
		{&g_vehicle_health_pub, &topic_vehicle_health, &g_control_ctx.vehicle_health},
		{&g_attitude_estimate_pub, &topic_attitude_estimate,
		 &g_control_ctx.attitude_estimate},
		{&g_attitude_command_pub, &topic_attitude_command, &g_control_ctx.attitude_command},
		{&g_control_loop_metrics_pub, &topic_control_loop_metrics,
		 &g_control_ctx.control_loop_metrics},
	};

	zros_node_init(&g_node, "cubs2_control");

	for (size_t i = 0U; i < ARRAY_SIZE(pubs); i++) {
		rc = zros_pub_init(pubs[i].pub, &g_node, pubs[i].topic, pubs[i].msg);

		if (rc != 0) {
			return rc;
		}
	}

	rc = zros_sub_init(&g_odometry_sub, &g_node, &topic_odometry,
			   &g_control_ctx.odometry, 0.0);
	if (rc != 0) {
		return rc;
	}
	rc = zros_sub_init(&g_manual_sub, &g_node, &topic_manual_control, &g_control_ctx.manual,
			   0.0);
	if (rc != 0) {
		return rc;
	}

	return 0;
}
static uint64_t control_timestamp_us(const struct control_context *ctx)
{
#if defined(CONFIG_BOARD_NATIVE_SIM) || defined(CONFIG_CUBS2_FASTDYN)
	if (ctx->lockstep_time_valid) {
		return ctx->lockstep_time_us;
	}

	return 0ULL;
#endif

	return (uint64_t)k_uptime_get() * 1000ULL;
}

static bool control_step_due(struct control_context *ctx)
{
#if defined(CONFIG_BOARD_NATIVE_SIM) || defined(CONFIG_CUBS2_FASTDYN)
	if (ctx->lockstep_time_us < ctx->next_control_time_us) {
		return false;
	}

	ctx->next_control_time_us =
		((ctx->lockstep_time_us / CUBS2_CONTROL_PERIOD_US) + 1U) * CUBS2_CONTROL_PERIOD_US;
#else
	ARG_UNUSED(ctx);
#endif

	return true;
}

static void update_telemetry(struct control_context *ctx, bool auto_mode, uint64_t timestamp_us)
{
	bool armed = !ctx->manual.valid || ctx->manual.rc.ch6 >= 1500;

	ctx->vehicle_health = (synapse_topic_VehicleHealthData_t){
		.timestamp_us = timestamp_us,
		.flight_mode = auto_mode ? 1U : 0U,
		.link_quality_pct = ctx->manual.valid ? 100U : 0U,
		.flags = armed ? synapse_topic_VehicleHealthFlags_Armed : 0U,
	};

	ctx->attitude_estimate = (synapse_topic_AttitudeEstimateData_t){
		.timestamp_us = timestamp_us,
		.angular_velocity_flu_rad_s =
			{
				.roll = (float)g_model.eulerRateEstimate_rad_s[0],
				.pitch = (float)g_model.eulerRateEstimate_rad_s[1],
				.yaw = (float)g_model.eulerRateEstimate_rad_s[2],
			},
	};
	csyn_quatf_from_euler((float)g_model.euler_rad[0], (float)g_model.euler_rad[1],
			      (float)g_model.euler_rad[2], &ctx->attitude_estimate.attitude);

	ctx->attitude_command = (synapse_topic_AttitudeCommandData_t){
		.timestamp_us = timestamp_us,
		.thrust = csyn_clampf((float)g_model.throttle, 0.0f, 1.0f),
	};
	csyn_quatf_from_euler((float)g_model.rollCommand, 0.0f, (float)g_model.desiredHeading,
			      &ctx->attitude_command.attitude);

	ctx->control_loop_metrics = (synapse_topic_ControlLoopMetricsData_t){
		.timestamp_us = timestamp_us,
		.period_us = CUBS2_CONTROL_PERIOD_US,
		.latency_us = ctx->main_loop_us,
	};

	(void)zros_pub_update(&g_vehicle_health_pub);
	(void)zros_pub_update(&g_attitude_estimate_pub);
	(void)zros_pub_update(&g_attitude_command_pub);
	(void)zros_pub_update(&g_control_loop_metrics_pub);
}

static void publish_outputs(struct control_context *ctx, bool auto_mode)
{
	uint64_t timestamp_us = control_timestamp_us(ctx);

	csyn_pwm_outputs_from_rc(&ctx->control_rc, &ctx->pwm_outputs, (int64_t)timestamp_us);
	(void)zros_pub_update(&g_pwm_outputs_pub);
	update_telemetry(ctx, auto_mode, timestamp_us);
}

int main(void)
{
	struct control_context *const ctx = &g_control_ctx;
	int rc;

	*ctx = (struct control_context){0};
	EFMI_INIT(FixedWingOuterLoop, &g_model);
	EFMI_RECALIBRATE(FixedWingOuterLoop, &g_model);

	rc = control_pubs_init();
	if (rc != 0) {
		return rc;
	}
	rc = cubs2_lockstep_start();
	if (rc != 0) {
		return rc;
	}

	LOG_INF("CUBS2 fixed-wing control starting");

	while (true) {
		uint32_t start_cycles = k_cycle_get_32();
		csyn_rc_channels16_t auto_rc = {0};
		bool odometry_updated;
		bool auto_mode;
		bool step_control;

#if defined(CONFIG_CUBS2_LOCKSTEP)
		if (cubs2_lockstep_enabled()) {
			if (cubs2_lockstep_receive(&ctx->odometry) != 0) {
				return -EIO;
			}
			ctx->lockstep_time_us = ctx->odometry.timestamp_us;
			ctx->lockstep_time_valid = true;
			odometry_updated = true;
		} else {
			if (zros_sub_wait(&g_odometry_sub, K_FOREVER) != 0) {
				continue;
			}
			odometry_updated = read_odometry_if_updated(ctx);
		}
		if (!odometry_updated) {
			continue;
		}
#else
		odometry_updated = read_odometry_if_updated(ctx);
#endif
		(void)read_manual_if_updated(ctx);

		auto_mode = auto_mode_selected(ctx);
		if (auto_mode && !ctx->previous_auto_mode) {
			EFMI_INIT(FixedWingOuterLoop, &g_model);
			EFMI_RECALIBRATE(FixedWingOuterLoop, &g_model);
		}
		ctx->previous_auto_mode = auto_mode;
		step_control = control_step_due(ctx);

		if (auto_mode) {
			if (step_control && odometry_valid(&ctx->odometry)) {
				fixed_wing_map_input(&g_model, &ctx->odometry);
				EFMI_STEP(FixedWingOuterLoop, &g_model);
				fixed_wing_map_output(&g_model, &auto_rc);
				ctx->control_rc = auto_rc;
			} else if (!odometry_valid(&ctx->odometry)) {
				idle_output(&auto_rc);
				ctx->control_rc = auto_rc;
			}
		} else {
			ctx->control_rc = ctx->manual.rc;
		}

		ctx->main_loop_us = k_cyc_to_us_floor32(k_cycle_get_32() - start_cycles);
		publish_outputs(ctx, auto_mode);
#if defined(CONFIG_CUBS2_LOCKSTEP)
		if (cubs2_lockstep_enabled()) {
			if (cubs2_lockstep_send(&ctx->pwm_outputs, &ctx->attitude_command) != 0) {
				return -EIO;
			}
		} else {
			k_yield();
		}
#else
		k_sleep(K_NSEC(CUBS2_FIXED_WING_OUTER_LOOP_PERIOD_NS));
#endif
	}

	return 0;
}
```

## src/csyn_topics.c
```c
/*
 * SPDX-License-Identifier: Apache-2.0
 */

#include <csyn/csyn.h>

#include <synapse/all_reader.h>

/* csyn carries only what the application declares; each key's final segment
 * resolves through the synapse_fbs 0.7.0 catalog. */
CSYN_TOPIC_DEFINE(manual, "manual", CSYN_DIR_RX,
                  sizeof(synapse_topic_ManualControlData_t));
#if defined(CONFIG_CUBS2_REALTIME)
CSYN_TOPIC_DEFINE(pose_raw, "qualisys/cub1/pose_raw", CSYN_DIR_RX,
                  sizeof(synapse_topic_RawPoseData_t));
#else
CSYN_TOPIC_DEFINE(odom, "odom", CSYN_DIR_RX,
                  sizeof(synapse_topic_OdometryData_t));
#endif
CSYN_TOPIC_DEFINE(pwm, "pwm", CSYN_DIR_TX,
                  sizeof(synapse_topic_PwmSignalOutputsData_t));
CSYN_TOPIC_DEFINE(health, "health", CSYN_DIR_TX,
                  sizeof(synapse_topic_VehicleHealthData_t));
CSYN_TOPIC_DEFINE(att, "att", CSYN_DIR_TX,
                  sizeof(synapse_topic_AttitudeEstimateData_t));
CSYN_TOPIC_DEFINE(att_sp, "att_sp", CSYN_DIR_TX,
                  sizeof(synapse_topic_AttitudeCommandData_t));
CSYN_TOPIC_DEFINE(loop, "loop", CSYN_DIR_TX,
                  sizeof(synapse_topic_ControlLoopMetricsData_t));
#if defined(CONFIG_CUBS2_REALTIME)
CSYN_TOPIC_DEFINE(mission, "mission", CSYN_DIR_TX,
                  sizeof(synapse_topic_MissionProgressData_t));
CSYN_TOPIC_DEFINE(pos_sp, "pos_sp", CSYN_DIR_TX,
                  sizeof(synapse_topic_LocalPositionCommandData_t));
CSYN_TOPIC_DEFINE(traj, "traj", CSYN_DIR_TX,
                  sizeof(synapse_topic_TrajectorySegmentData_t));
CSYN_TOPIC_DEFINE(nav, "nav", CSYN_DIR_TX,
                  sizeof(synapse_topic_NavigationTargetData_t));
#endif
```

## src/cubs2_efmi_control.h
```c
#ifndef CUBS2_EFMI_CONTROL_H_
#define CUBS2_EFMI_CONTROL_H_

#include "FixedWingOuterLoop.h"
#include "efmi_wrapper.h"

#define CUBS2_FIXED_WING_OUTER_LOOP_PERIOD_S 0.02
#define CUBS2_FIXED_WING_OUTER_LOOP_PERIOD_NS 20000000

static inline void cubs2_efmi_fixed_wing_outer_loop_init(FixedWingOuterLoopState *state)
{
	CUBS2_EFMI_INIT(FixedWingOuterLoop, state);
}

static inline void cubs2_efmi_fixed_wing_outer_loop_recalibrate(FixedWingOuterLoopState *state)
{
	CUBS2_EFMI_RECALIBRATE(FixedWingOuterLoop, state);
}

static inline void cubs2_efmi_fixed_wing_outer_loop_step(FixedWingOuterLoopState *state)
{
	CUBS2_EFMI_STEP(FixedWingOuterLoop, state);
}

#endif
```

## src/efmi_wrapper.h
```c
#ifndef EFMI_WRAPPER_H_
#define EFMI_WRAPPER_H_

#define EFMI_CAT_(a, b) a##b
#define EFMI_CAT(a, b) EFMI_CAT_(a, b)
#define EFMI_CAT3_(a, b, c) a##b##c
#define EFMI_CAT3(a, b, c) EFMI_CAT3_(a, b, c)

#define EFMI_STATE_TYPE(model) EFMI_CAT(model, State)
#define EFMI_STATE(model, name) EFMI_STATE_TYPE(model) name
#define EFMI_METHOD(model, method) EFMI_CAT3(model, _, method)

#define EFMI_INIT(model, state_ptr)                                                               \
	do {                                                                                     \
		*(state_ptr) = (EFMI_STATE_TYPE(model)){0};                                      \
		EFMI_METHOD(model, startup)(state_ptr);                                          \
		EFMI_METHOD(model, recalibrate)(state_ptr);                                      \
	} while (0)

#define EFMI_RECALIBRATE(model, state_ptr) EFMI_METHOD(model, recalibrate)(state_ptr)
#define EFMI_STEP(model, state_ptr) EFMI_METHOD(model, dostep)(state_ptr)

#endif
```

## src/fastdyn_board.c
```c
/* SPDX-License-Identifier: Apache-2.0 */

#include <fsl_clock.h>

/* Physical strap/reset sequencing uses DWT delays and is unnecessary when the
 * firmware communicates exclusively through the FastDyn ENET model. */
void board_early_init_hook(void)
{
}

/* QEMU owns CPU time. Keep MCUX clock queries internally consistent without
 * polling analog DCDC/PLL status registers that do not exist in rehosting. */
void clock_init(void)
{
	CLOCK_SetXtalFreq(24000000U);
	CLOCK_SetRtcXtalFreq(32768U);
	CLOCK_SetMux(kCLOCK_PeriphClk2Mux, 1U);
	CLOCK_SetMux(kCLOCK_PeriphMux, 1U);
	SystemCoreClock = 24000000U;
}

uint32_t CLOCK_GetAhbFreq(void)
{
	return 24000000U;
}

uint32_t CLOCK_GetIpgFreq(void)
{
	return 24000000U;
}

uint32_t CLOCK_GetPerClkFreq(void)
{
	return 24000000U;
}

uint32_t CLOCK_GetFreq(clock_name_t name)
{
	return name == kCLOCK_RtcClk ? 32768U : 24000000U;
}
```

## src/main_sil.c
```c
/*
 * SPDX-License-Identifier: Apache-2.0
 */

#include <csyn/csyn.h>
#include <csyn/csyn_codec.h>
#include <csyn/csyn_zros.h>

#include "Vehicles_Cubs2_OuterLoop.h"
#include "lockstep.h"
#include "runtime_control.h"

#include <math.h>
#include <stdbool.h>
#include <stdint.h>

#include <zephyr/kernel.h>
#include <zephyr/logging/log.h>

#include <zros/private/zros_node_struct.h>
#include <zros/private/zros_pub_struct.h>
#include <zros/private/zros_sub_struct.h>
#include <zros/zros_node.h>
#include <zros/zros_pub.h>
#include <zros/zros_sub.h>
#include <zros/zros_topic.h>

LOG_MODULE_REGISTER(cubs2, LOG_LEVEL_INF);

#define CUBS2_FIXED_WING_OUTER_LOOP_PERIOD_NS 20000000
#define CUBS2_CONTROL_PERIOD_US (CUBS2_FIXED_WING_OUTER_LOOP_PERIOD_NS / 1000U)

struct control_context {
  synapse_topic_OdometryData_t odometry;
  struct csyn_manual_control manual;
  csyn_rc_channels16_t control_rc;
  synapse_topic_PwmSignalOutputsData_t pwm_outputs;
  synapse_topic_VehicleHealthData_t vehicle_health;
  synapse_topic_AttitudeEstimateData_t attitude_estimate;
  synapse_topic_AttitudeCommandData_t attitude_command;
  synapse_topic_ControlLoopMetricsData_t control_loop_metrics;
  uint32_t main_loop_us;
  uint64_t lockstep_time_us;
  uint64_t next_control_time_us;
  uint32_t estimator_control_steps;
  bool lockstep_time_valid;
  bool previous_auto_mode;
};

static Vehicles_Cubs2_OuterLoopState g_model;
static struct control_context g_control_ctx;
static struct zros_node g_node;
static struct zros_pub g_pwm_outputs_pub;
static struct zros_pub g_vehicle_health_pub;
static struct zros_pub g_attitude_estimate_pub;
static struct zros_pub g_attitude_command_pub;
static struct zros_pub g_control_loop_metrics_pub;
static struct zros_sub g_odometry_sub;
static struct zros_sub g_manual_sub;

static bool read_odometry_if_updated(struct control_context *ctx) {
  if (zros_sub_update(&g_odometry_sub) != 0) {
    return false;
  }

  ctx->lockstep_time_us = ctx->odometry.timestamp_us;
  ctx->lockstep_time_valid = true;
  return true;
}

static bool read_manual_if_updated(struct control_context *ctx) {
  return zros_sub_update(&g_manual_sub) == 0;
}

static bool odometry_valid(const synapse_topic_OdometryData_t *odom) {
  const uint32_t required = synapse_topic_OdometryFlags_PositionValid |
                            synapse_topic_OdometryFlags_AttitudeValid |
                            synapse_topic_OdometryFlags_LinearVelocityValid |
                            synapse_topic_OdometryFlags_AngularVelocityValid;
  const uint32_t reject = synapse_topic_OdometryFlags_OutlierRejected |
                          synapse_topic_OdometryFlags_Lost;
  uint32_t flags = odom->flags;

  return (flags & required) == required && (flags & reject) == 0U &&
         odom->status != synapse_topic_OdometryStatus_Lost &&
         odom->status != synapse_topic_OdometryStatus_OutlierRejected;
}

static void fixed_wing_map_input(Vehicles_Cubs2_OuterLoopState *model,
                                 const synapse_topic_OdometryData_t *odom) {
  float roll = 0.0f;
  float pitch = 0.0f;
  float yaw = 0.0f;

  /* The CUBS2 outer loop consumes Euler [roll, pitch, yaw] in radians. */
  csyn_euler_from_quatf(&odom->pose.attitude, &roll, &pitch, &yaw);

  model->position_m[0] = odom->pose.position_enu_m.x;
  model->position_m[1] = odom->pose.position_enu_m.y;
  model->position_m[2] = odom->pose.position_enu_m.z;
  model->euler_rad[0] = roll;
  model->euler_rad[1] = pitch;
  model->euler_rad[2] = yaw;
  model->velocity_m_s[0] = odom->twist.linear_velocity_enu_m_s.x;
  model->velocity_m_s[1] = odom->twist.linear_velocity_enu_m_s.y;
  model->velocity_m_s[2] = odom->twist.linear_velocity_enu_m_s.z;
  model->eulerRate_rad_s[0] = odom->twist.angular_velocity_flu_rad_s.roll;
  model->eulerRate_rad_s[1] = odom->twist.angular_velocity_flu_rad_s.pitch;
  model->eulerRate_rad_s[2] = odom->twist.angular_velocity_flu_rad_s.yaw;
}

static void fixed_wing_map_output(const Vehicles_Cubs2_OuterLoopState *model,
                                  csyn_rc_channels16_t *rc) {
  *rc = (csyn_rc_channels16_t){
      .ch0 = csyn_pwm_from_centered_axis(-(float)model->aileron),
      .ch1 = csyn_pwm_from_centered_axis(-(float)model->elevator),
      .ch2 = csyn_pwm_from_throttle_axis((float)model->throttle),
      .ch3 = csyn_pwm_from_centered_axis((float)model->rudder),
      .ch4 = (int32_t)csyn_clampf((float)model->stabilizer, 1000.0f, 2000.0f),
      .ch5 = (int32_t)model->currentWaypoint,
      .ch6 = (int32_t)(1000.0f * (float)model->desiredSpeed),
      .ch7 = (int32_t)(1000.0f * (float)model->rollCommand),
      .ch8 = (int32_t)(1000.0f * (float)model->courseError),
  };
}

static void idle_output(csyn_rc_channels16_t *rc) {
  *rc = (csyn_rc_channels16_t){
      .ch0 = 1500,
      .ch1 = 1500,
      .ch2 = 1000,
      .ch3 = 1500,
      .ch4 = 1000,
  };
}

static bool manual_control_valid(const struct csyn_manual_control *manual,
                                 int32_t *switch_us) {
  const int32_t *channels = csyn_rc_channels_data(&manual->rc);
  bool valid = manual->valid;

  *switch_us = channels[CONFIG_CUBS2_AUTO_SWITCH_CHANNEL];

  for (size_t i = 0U; i < 5U; i++) {
    valid = valid && (channels[i] >= 900) && (channels[i] <= 2100);
  }

  return valid && (*switch_us >= 900) && (*switch_us <= 2100);
}

static bool auto_mode_selected(const struct control_context *ctx) {
#if defined(CONFIG_CUBS2_MANUAL_OVERRIDE)
  int32_t switch_us;

  return !manual_control_valid(&ctx->manual, &switch_us) ||
         (switch_us > CONFIG_CUBS2_AUTO_SWITCH_THRESHOLD_US);
#else
  ARG_UNUSED(ctx);
  return true;
#endif
}

static int control_pubs_init(void) {
  int rc;
  struct {
    struct zros_pub *pub;
    struct zros_topic *topic;
    void *msg;
  } pubs[] = {
      {&g_pwm_outputs_pub, &topic_pwm_signal_outputs,
       &g_control_ctx.pwm_outputs},
      {&g_vehicle_health_pub, &topic_vehicle_health,
       &g_control_ctx.vehicle_health},
      {&g_attitude_estimate_pub, &topic_attitude_estimate,
       &g_control_ctx.attitude_estimate},
      {&g_attitude_command_pub, &topic_attitude_command,
       &g_control_ctx.attitude_command},
      {&g_control_loop_metrics_pub, &topic_control_loop_metrics,
       &g_control_ctx.control_loop_metrics},
  };

  zros_node_init(&g_node, "cubs2_control");

  for (size_t i = 0U; i < ARRAY_SIZE(pubs); i++) {
    rc = zros_pub_init(pubs[i].pub, &g_node, pubs[i].topic, pubs[i].msg);

    if (rc != 0) {
      return rc;
    }
  }

  rc = zros_sub_init(&g_odometry_sub, &g_node, &topic_odometry,
                     &g_control_ctx.odometry, 0.0);
  if (rc != 0) {
    return rc;
  }
  rc = zros_sub_init(&g_manual_sub, &g_node, &topic_manual_control,
                     &g_control_ctx.manual, 0.0);
  if (rc != 0) {
    return rc;
  }

  return 0;
}
static uint64_t control_timestamp_us(const struct control_context *ctx) {
#if defined(CONFIG_BOARD_NATIVE_SIM) || defined(CONFIG_CUBS2_FASTDYN)
  if (ctx->lockstep_time_valid) {
    return ctx->lockstep_time_us;
  }

  return 0ULL;
#endif

  return (uint64_t)k_uptime_get() * 1000ULL;
}

static bool control_step_due(struct control_context *ctx) {
#if defined(CONFIG_BOARD_NATIVE_SIM) || defined(CONFIG_CUBS2_FASTDYN)
  if (ctx->lockstep_time_us < ctx->next_control_time_us) {
    return false;
  }

  ctx->next_control_time_us =
      ((ctx->lockstep_time_us / CUBS2_CONTROL_PERIOD_US) + 1U) *
      CUBS2_CONTROL_PERIOD_US;
#else
  ARG_UNUSED(ctx);
#endif

  return true;
}

static uint8_t attitude_estimate_flags(const struct control_context *ctx,
                                       bool odometry_ok) {
  const bool attitude_finite = isfinite(g_model.euler_rad[0]) &&
                               isfinite(g_model.euler_rad[1]) &&
                               isfinite(g_model.euler_rad[2]);
  const bool rates_finite = isfinite(g_model.eulerRateEstimate_rad_s[0]) &&
                            isfinite(g_model.eulerRateEstimate_rad_s[1]) &&
                            isfinite(g_model.eulerRateEstimate_rad_s[2]);
  uint8_t flags = 0U;

  if (odometry_ok && ctx->estimator_control_steps >= 1U && attitude_finite) {
    flags |= synapse_topic_AttitudeEstimateFlags_AttitudeValid;
  }
  if (odometry_ok && ctx->estimator_control_steps >= 2U && rates_finite) {
    flags |= synapse_topic_AttitudeEstimateFlags_RatesValid;
  }

  return flags;
}

static void update_telemetry(struct control_context *ctx, bool auto_mode,
                             uint64_t timestamp_us) {
  bool armed = !ctx->manual.valid || ctx->manual.rc.ch6 >= 1500;
  bool odometry_ok = odometry_valid(&ctx->odometry);
  uint8_t health_flags = armed ? synapse_topic_VehicleHealthFlags_Armed : 0U;

  if (auto_mode && !odometry_ok) {
    health_flags |= synapse_topic_VehicleHealthFlags_Failsafe;
  }

  ctx->vehicle_health = (synapse_topic_VehicleHealthData_t){
      .timestamp_us = timestamp_us,
      .flight_mode = auto_mode ? 1U : 0U,
      .link_quality_pct = ctx->manual.valid ? 100U : 0U,
      .flags = health_flags,
  };

  ctx->attitude_estimate = (synapse_topic_AttitudeEstimateData_t){
      .timestamp_us = timestamp_us,
      .flags = attitude_estimate_flags(ctx, odometry_ok),
      .angular_velocity_flu_rad_s =
          {
              .roll = (float)g_model.eulerRateEstimate_rad_s[0],
              .pitch = (float)g_model.eulerRateEstimate_rad_s[1],
              .yaw = (float)g_model.eulerRateEstimate_rad_s[2],
          },
  };
  csyn_quatf_from_euler(
      (float)g_model.euler_rad[0], (float)g_model.euler_rad[1],
      (float)g_model.euler_rad[2], &ctx->attitude_estimate.attitude);

  ctx->attitude_command = (synapse_topic_AttitudeCommandData_t){
      .timestamp_us = timestamp_us,
      .thrust = csyn_clampf((float)g_model.throttle, 0.0f, 1.0f),
  };
  csyn_quatf_from_euler((float)g_model.rollCommand, 0.0f,
                        (float)g_model.desiredHeading,
                        &ctx->attitude_command.attitude);

  ctx->control_loop_metrics = (synapse_topic_ControlLoopMetricsData_t){
      .timestamp_us = timestamp_us,
      .period_us = CUBS2_CONTROL_PERIOD_US,
      .latency_us = ctx->main_loop_us,
  };

  (void)zros_pub_update(&g_vehicle_health_pub);
  (void)zros_pub_update(&g_attitude_estimate_pub);
  (void)zros_pub_update(&g_attitude_command_pub);
  (void)zros_pub_update(&g_control_loop_metrics_pub);
}

static void publish_outputs(struct control_context *ctx, bool auto_mode) {
  uint64_t timestamp_us = control_timestamp_us(ctx);

  csyn_pwm_outputs_from_rc(&ctx->control_rc, &ctx->pwm_outputs,
                           (int64_t)timestamp_us);
  (void)zros_pub_update(&g_pwm_outputs_pub);
  update_telemetry(ctx, auto_mode, timestamp_us);
}

int main(void) {
  struct control_context *const ctx = &g_control_ctx;
  int rc;

  *ctx = (struct control_context){0};
  EFMI_INIT(Vehicles_Cubs2_OuterLoop, &g_model);
  EFMI_RECALIBRATE(Vehicles_Cubs2_OuterLoop, &g_model);
  if (!cubs2_runtime_control_init(&g_model)) {
    LOG_ERR("failed to register runtime configuration services");
    return -1;
  }

  rc = control_pubs_init();
  if (rc != 0) {
    return rc;
  }
  rc = cubs2_lockstep_start();
  if (rc != 0) {
    return rc;
  }

  LOG_INF("CUBS2 fixed-wing control starting");

  while (true) {
    uint32_t start_cycles = k_cycle_get_32();
    csyn_rc_channels16_t auto_rc = {0};
    bool odometry_updated;
    bool odometry_ok;
    bool auto_mode;
    bool step_control;

#if defined(CONFIG_CUBS2_LOCKSTEP)
    if (cubs2_lockstep_enabled()) {
      if (cubs2_lockstep_receive(&ctx->odometry) != 0) {
        return -EIO;
      }
      ctx->lockstep_time_us = ctx->odometry.timestamp_us;
      ctx->lockstep_time_valid = true;
      odometry_updated = true;
    } else {
      if (zros_sub_wait(&g_odometry_sub, K_FOREVER) != 0) {
        continue;
      }
      odometry_updated = read_odometry_if_updated(ctx);
    }
    if (!odometry_updated) {
      continue;
    }
#else
    odometry_updated = read_odometry_if_updated(ctx);
#endif
    (void)read_manual_if_updated(ctx);

    auto_mode = auto_mode_selected(ctx);
    if (auto_mode && !ctx->previous_auto_mode) {
      EFMI_INIT(Vehicles_Cubs2_OuterLoop, &g_model);
      EFMI_RECALIBRATE(Vehicles_Cubs2_OuterLoop, &g_model);
      cubs2_runtime_control_restore(&g_model);
      ctx->estimator_control_steps = 0U;
    }
    ctx->previous_auto_mode = auto_mode;
    cubs2_runtime_control_apply(&g_model, !ctx->manual.valid ||
                                              ctx->manual.rc.ch6 >= 1500);
    step_control = control_step_due(ctx);
    odometry_ok = odometry_valid(&ctx->odometry);

    if (auto_mode) {
      if (step_control && odometry_ok) {
        fixed_wing_map_input(&g_model, &ctx->odometry);
        g_model.engaged = 1.0;
        EFMI_STEP(Vehicles_Cubs2_OuterLoop, &g_model);
        if (ctx->estimator_control_steps < UINT32_MAX) {
          ctx->estimator_control_steps++;
        }
        fixed_wing_map_output(&g_model, &auto_rc);
        ctx->control_rc = auto_rc;
      } else if (!odometry_ok) {
        ctx->estimator_control_steps = 0U;
        idle_output(&auto_rc);
        ctx->control_rc = auto_rc;
      }
    } else {
      ctx->control_rc = ctx->manual.rc;
    }

    ctx->main_loop_us = k_cyc_to_us_floor32(k_cycle_get_32() - start_cycles);
    publish_outputs(ctx, auto_mode);
#if defined(CONFIG_CUBS2_LOCKSTEP)
    if (cubs2_lockstep_enabled()) {
      if (cubs2_lockstep_send(&ctx->pwm_outputs, &ctx->attitude_command) != 0) {
        return -EIO;
      }
    } else {
      k_yield();
    }
#else
    k_sleep(K_NSEC(CUBS2_FIXED_WING_OUTER_LOOP_PERIOD_NS));
#endif
  }

  return 0;
}
```

## src/native_sil_host.c
```c
/* SPDX-License-Identifier: Apache-2.0 */

#define _POSIX_C_SOURCE 200809L

#include <fcntl.h>
#include <stddef.h>
#include <sys/mman.h>
#include <sys/stat.h>
#include <unistd.h>

void *cubs2_native_sil_host_map(const char *path, unsigned long size)
{
	int fd = open(path, O_RDWR);
	struct stat status;
	void *mapping;

	if (fd < 0) {
		return NULL;
	}
	if (fstat(fd, &status) != 0 || status.st_size < (off_t)size) {
		close(fd);
		return NULL;
	}
	mapping = mmap(NULL, size, PROT_READ | PROT_WRITE, MAP_SHARED, fd, 0);
	close(fd);
	return mapping == MAP_FAILED ? NULL : mapping;
}

void cubs2_native_sil_host_unmap(void *mapping, unsigned long size)
{
	if (mapping != NULL) {
		(void)munmap(mapping, size);
	}
}
```

## src/native_sil_transport.c
```c
/* SPDX-License-Identifier: Apache-2.0 */

#include "native_sil_transport.h"

#include <stdbool.h>

#if defined(CONFIG_BOARD_NATIVE_SIM)

#include <nsi_host_trampolines.h>
#include <nsi_main.h>

#include <errno.h>

#include <cerebri_lockstep/sequence.h>

void *cubs2_native_sil_host_map(const char *path, unsigned long size);
void cubs2_native_sil_host_unmap(void *mapping, unsigned long size);

static struct cubs2_native_sil_shared *g_native_sil_shared;
static struct cerebri_lockstep_sequence g_native_sil_lockstep;

int cubs2_native_sil_transport_start(void)
{
	char *path = nsi_host_getenv("CUBS2_NATIVE_SIL_SHM");

	if (path == NULL || path[0] == '\0') {
		return 0;
	}
	g_native_sil_shared = cubs2_native_sil_host_map(path, sizeof(*g_native_sil_shared));
	if (g_native_sil_shared == NULL) {
		return -EIO;
	}
	if (g_native_sil_shared->magic != CUBS2_NATIVE_SIL_MAGIC) {
		cubs2_native_sil_host_unmap(g_native_sil_shared, sizeof(*g_native_sil_shared));
		g_native_sil_shared = NULL;
		return -EIO;
	}
	return cerebri_lockstep_sequence_init(
		&g_native_sil_lockstep, &g_native_sil_shared->odometry_sequence,
		&g_native_sil_shared->response_sequence, &g_native_sil_shared->terminate,
		nsi_host_getenv("CUBS2_NATIVE_SIL_COOPERATIVE") != NULL);
}

bool cubs2_native_sil_transport_enabled(void)
{
	return g_native_sil_shared != NULL;
}

int cubs2_native_sil_transport_receive(synapse_topic_ExternalOdometryData_t *odometry)
{
	int rc = cerebri_lockstep_sequence_wait(&g_native_sil_lockstep);

	if (rc == -ECANCELED) {
		nsi_exit(0);
	}
	if (rc != 0) {
		return rc;
	}
	*odometry = g_native_sil_shared->odometry;
	return 0;
}

int cubs2_native_sil_transport_send(const synapse_topic_PwmSignalOutputsData_t *pwm,
				    const synapse_topic_AttitudeCommandData_t *attitude)
{
	g_native_sil_shared->pwm = *pwm;
	g_native_sil_shared->attitude = *attitude;
	cerebri_lockstep_sequence_respond(&g_native_sil_lockstep);
	return 0;
}

#else

int cubs2_native_sil_transport_start(void)
{
	return 0;
}

bool cubs2_native_sil_transport_enabled(void)
{
	return false;
}

int cubs2_native_sil_transport_receive(synapse_topic_ExternalOdometryData_t *odometry)
{
	(void)odometry;
	return -1;
}

int cubs2_native_sil_transport_send(const synapse_topic_PwmSignalOutputsData_t *pwm,
				    const synapse_topic_AttitudeCommandData_t *attitude)
{
	(void)pwm;
	(void)attitude;
	return -1;
}

#endif
```

## src/native_sil_transport.h
```c
/* SPDX-License-Identifier: Apache-2.0 */

#ifndef CUBS2_NATIVE_SIL_TRANSPORT_H_
#define CUBS2_NATIVE_SIL_TRANSPORT_H_

#include <stdbool.h>
#include <stdint.h>

#include <synapse/control_reader.h>
#include <synapse/state_reader.h>

#define CUBS2_NATIVE_SIL_MAGIC UINT32_C(0x43554253)

struct cubs2_native_sil_shared {
	uint32_t magic;
	uint32_t odometry_sequence;
	uint32_t response_sequence;
	uint32_t terminate;
	synapse_topic_ExternalOdometryData_t odometry;
	synapse_topic_PwmSignalOutputsData_t pwm;
	synapse_topic_AttitudeCommandData_t attitude;
};

_Static_assert(sizeof(struct cubs2_native_sil_shared) == 176,
		       "native SIL shared layout mismatch");

int cubs2_native_sil_transport_start(void);
bool cubs2_native_sil_transport_enabled(void);
int cubs2_native_sil_transport_receive(synapse_topic_ExternalOdometryData_t *odometry);
int cubs2_native_sil_transport_send(const synapse_topic_PwmSignalOutputsData_t *pwm,
				    const synapse_topic_AttitudeCommandData_t *attitude);

#endif
```

## src/runtime_control.h
```c
/* SPDX-License-Identifier: Apache-2.0 */
#ifndef CUBS2_RUNTIME_CONTROL_H_
#define CUBS2_RUNTIME_CONTROL_H_

#include <stdbool.h>

#include "Vehicles_Cubs2_OuterLoop.h"

/* Register Synapse ParamSet/Get and TrajectorySet/Get services.  Incoming
 * changes are staged by the Zenoh thread and applied atomically by
 * cubs2_runtime_control_apply() on the 50 Hz controller thread. */
#if defined(CONFIG_CUBS2_RUNTIME_CONTROL)
bool cubs2_runtime_control_init(Vehicles_Cubs2_OuterLoopState *model);
void cubs2_runtime_control_apply(Vehicles_Cubs2_OuterLoopState *model, bool armed);
void cubs2_runtime_control_restore(Vehicles_Cubs2_OuterLoopState *model);
#else
static inline bool cubs2_runtime_control_init(Vehicles_Cubs2_OuterLoopState *model) {
  (void)model;
  return true;
}

static inline void cubs2_runtime_control_apply(Vehicles_Cubs2_OuterLoopState *model,
                                               bool armed) {
  (void)model;
  (void)armed;
}

static inline void
cubs2_runtime_control_restore(Vehicles_Cubs2_OuterLoopState *model) {
  (void)model;
}
#endif

#endif
```
